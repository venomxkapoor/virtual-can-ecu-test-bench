VERSION ""

NS_ :

BS_:

BU_: Tester ECU

BO_ 256 ECU_STATUS: 2 ECU
 SG_ state : 0|8@1+ (1,0) [0|2] "" Tester
 SG_ alive_counter : 8|8@1+ (1,0) [0|15] "" Tester

BO_ 512 SENSOR_DATA: 4 ECU
 SG_ battery_voltage : 0|16@1+ (0.1,0) [0|6553.5] "V" Tester
 SG_ temperature : 16|16@1- (0.1,0) [-3276.8|3276.7] "C" Tester

CM_ "DBC file for Virtual CAN ECU Test Bench";
VAL_ 256 state 0 "OFF" 1 "RUN" 2 "FAULT" ;
